## drivers/input/touchscreen/mediatek/Kconfig
```kconfig
#
# Touchscreen driver configuration
#
menuconfig INPUT_TOUCHSCREEN
	bool "Touchscreens"
	help
	  Say Y here, and a list of supported touchscreens will be displayed.
	  This option doesn't affect the kernel.

	  If unsure, say Y.

if INPUT_TOUCHSCREEN

config TOUCHSCREEN_MTK
	bool "MediaTek Touch Panel Driver"
	help
	  Say Y here if you have MediaTek touch panel.

	  If unsure, say N.

	  To compile this dirver as a module, choose M here: the
	  module will be called.

config TOUCHSCREEN_AEON_GT1X
	bool "GT1X for Eastaeon package"
	default n
	help
	  Say Y here if you have GT1X touch panel.

	  If unsure, say N.

	  To compile this dirver as a module, choose M here: the
	  module will be called.

config TOUCHSCREEN_AEON_GT9XX
	bool "GT9XX for Eastaeon package"
	default n
	help
	  Say Y here if you have GT9XX touch panel.

	  If unsure, say N.

	  To compile this dirver as a module, choose M here: the
	  module will be called.

config TOUCHSCREEN_AEON_SYNAPTICS_S2714
	bool "SYNAPTICS_S2714 for Eastaeon package"
	default n
	help
	  Say Y here if you have synaptics_s2714 touch panel.

	  If unsure, say N.

	  To compile this dirver as a module, choose M here: the
	  module will be called.

config TOUCHSCREEN_AEON_FACTORY_CTP
	bool "aeon_factory_ctp for Eastaeon package"
	default n
	help
	  Say Y here if you have aeon_factory_ctp touch panel.

	  If unsure, say N.

	  To compile this dirver as a module, choose M here: the
	  module will be called.

config TOUCHSCREEN_MTK_MSG22XX
	bool "MSG22XX for Mediatek package"
	default n
	help
	  Say Y here if you have MSG22XX touch panel.

	  If unsure, say N.

	  To compile this dirver as a module, choose M here: the
	  module will be called.

config TOUCHSCREEN_AEON_FT5X0X
        bool "aeon_ft5x0x for Eastaeon package"
	default n
	help
	  Say Y here if you have aeon_ft5x0x touch panel.

	  If unsure, say N.

	  To compile this dirver as a module, choose M here: the
	  module will be called.

config TOUCHSCREEN_AEON_FOCALTECH
	bool "aeon_focaltech for Eastaeon package"
	default n
	help
	  Say Y here if you have aeon_focaltech touch panel.

	  If unsure, say N.

	  To compile this dirver as a module, choose M here: the
	  module will be called.


config TOUCHSCREEN_AEON_SYNAPTICS_S2714_8536
        bool "SYNAPTICS_S2714  for AEON package"
	default n
	help
	  Say Y here if you have synaptics s2714 touch panel.

	  If unsure, say N.

	  To compile this dirver as a module, choose M here: the
	  module will be called.

source "drivers/input/touchscreen/mediatek/aeon_synaptics_s2714_8536/Kconfig"

config TOUCHSCREEN_AEON_FT5X0X_8536
        bool "ft5x0x  for AEON package"
	default n
	help
	  Say Y here if you have ft5x0x touch panel.

	  If unsure, say N.

	  To compile this dirver as a module, choose M here: the
	  module will be called.

source "drivers/input/touchscreen/mediatek/aeon_ft5x0x_hd720_lide_8536/Kconfig"

config TOUCHSCREEN_MTK_AEON_NT11205_HD720_HLT_8536
	bool "aeon_nt11205_hd720_hlt_8536 for Mediatek package"
	default n
	help
	  Say Y here if you have aeon_nt11205_hd720_hlt_8536 touch panel.

	  If unsure, say N.

	  To compile this dirver as a module, choose M here: the
	  module will be called.

source "drivers/input/touchscreen/mediatek/aeon_nt11205_hd720_hlt_8536/Kconfig"	  

config TOUCHSCREEN_AEON_FT5X0X_8630
	bool "aeon touchscreen ft5x0x 8630 for Eastaeon package"
	default n
	help
	  Say Y here if you have aeon_ft5x0x touch panel.

	  If unsure, say N.

	  To compile this dirver as a module, choose M here: the
	  module will be called.
source "drivers/input/touchscreen/mediatek/aeon_ft5x0x_hd720_lide_8630/Kconfig"

config TOUCHSCREEN_AEON_MSTAR_8630
	bool "aeon_mstar_8630_v3.14 for Eastaeon package"
	default n
	help
	  Say Y here if you have mstar touch panel.

	  If unsure, say N.

	  To compile this dirver as a module, choose M here: the
	  module will be called.


endif
```
